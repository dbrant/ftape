## olddocs/Kconfig
```kconfig
#
# QIC-117 floppy tape driver configuration
#

config FTAPE
	tristate "QIC-117 floppy tape support"
	depends on ISA || PARPORT
	help
	  If you have a tape drive that is connected to your floppy
	  controller, say Y here.

	  Some tape drives (like the Seagate "Tape Store 3200" or the Iomega
	  "Ditto 3200" or the Exabyte "Eagle TR-3") come with a "high speed"
	  controller of their own. These drives (and their companion
	  controllers) are also supported if you say Y here.

	  If you have a special controller (such as the CMS FC-10, FC-20,
	  Mountain Mach-2, or any controller that is based on the Intel 82078
	  FDC), you must configure it by selecting the appropriate entries
	  from the "Floppy tape controllers" sub-menu below and possibly
	  modify the default values for the IRQ and DMA channel and the IO
	  base in ftape's configuration menu.

	  If you want to use your floppy tape drive on a PCI-bus based system,
	  please read the file <file:Documentation/ftape.txt>.

	  The ftape kernel driver is also available as a runtime loadable
	  module ( = code which can be inserted in and removed from the
	  running kernel whenever you want). If you want to compile it as a
	  module, say M here and read <file:Documentation/kmod.txt>.

	  Note that the Ftape-HOWTO is out of date (sorry) and documents the
	  older version 2.x of this software but still contains useful
	  information.  There is a web page with more recent documentation at
	  <http://ftape.instmath.rwth-aachen.de/>.

config FTAPE_INTERNAL
	tristate "Internal floppy tape controller support"
	depends on FTAPE && ISA
	help
	  If you have a floppy tape drive that is connected to your floppy
	  disk controller, say Y here. This is the most common type of
	  connection.

config FTAPE_PARPORT
	tristate "Parallel port floppy tape support"
	depends on FTAPE && PARPORT
	help
	  If you have a parallel port floppy tape drive (such as the
	  Colorado Trakker or Micro Solutions BackPack), say Y here.

config FTAPE_TRAKKER
	tristate "HP Colorado Trakker support"
	depends on FTAPE_PARPORT
	help
	  Support for HP Colorado Trakker parallel port tape drives.

config FTAPE_BPCK
	tristate "Micro Solutions BackPack support"
	depends on FTAPE_PARPORT
	help
	  Support for Micro Solutions BackPack parallel port tape drives.

config ZFTAPE
	tristate "Zftape, the VFS interface"
	depends on FTAPE
	help
	  The zftape VFS interface for the ftape floppy tape driver.
	  Zftape lets you access your floppy tape drive in the same way
	  as any other block device.

	  To compile this driver as a module, choose M here: the
	  module will be called zftape.

config ZFT_DFLT_BLK_SZ
	int "Default block size"
	depends on ZFTAPE
	default "10240"
	help
	  If unsure, leave this at the default value of 10240. Note that
	  you can change this at module load time or at driver compilation
	  time. Please read <file:Documentation/ftape.txt> for more
	  information.

config FT_PROC_FS
	bool "Enable /proc filesystem interface"
	depends on FTAPE && PROC_FS
	help
	  Optional /proc/ftape interface

config ZFT_COMPRESSOR
	tristate "zftape compression support"
	depends on ZFTAPE
	help
	  Support for transparent decompression and compression.

config FT_IGNORE_ECC_ERRS
	bool "Ignore ECC errors by default"
	depends on FTAPE
	help
	  If enabled, ftape will ignore ECC errors by default and proceed
	  to the next segment. This can be useful for reading damaged tapes.

config FT_SOFT_RETRIES
	int "Number of soft retries"
	depends on FTAPE
	default "6"
	help
	  Number of low-level soft retries. Default is 6. Setting this to 1
	  will skip over bad segments faster but may result in more read errors.
```

## scripts/kernel-inclusion/v2.0/Config.in
```kconfig
#
# Ftape configuration
#
if [ "$CONFIG_ZFTAPE" != "y" -a "$CONFIG_ZFTAPE" != "m" ]; then
    define_bool CONFIG_ZFTAPE m
    comment 'The zftape module will also be build as module'
fi
dep_tristate 'Zftape, the VFS interface' CONFIG_ZFTAPE $CONFIG_FTAPE m
bool 'Enable read-back of ftape-3.x compressed archives' CONFIG_FT_UNCMPR n
if [ "$CONFIG_FT_UNCMPR" = "y" ]; then
    comment 'The de-compressor will be built as a module only!'
    define_bool CONFIG_ZFT_COMPRESSOR m
else
    define_bool CONFIG_ZFT_COMPRESSOR n
fi
comment 'General ftape options'
int 'Default block size' CONFIG_ZFT_DFLT_BLK_SZ 10240
choice 'Debugging output'			\
	"Normal		CONFIG_FT_NORMAL_DEBUG	\
	 Excessive	CONFIG_FT_FULL_DEBUG	\
	 Reduced	CONFIG_FT_NO_TRACE	\
	 None		CONFIG_FT_NO_TRACE_AT_ALL" Normal
if [ "$CONFIG_PROC_FS" = "y" ]; then
  bool 'Enable procfs status report (+2kb)' CONFIG_FT_PROC_FS y
fi
comment 'FDC drivers'
dep_tristate 'Driver for internal FDCs (FC-10/FC-20/82078/Ditto EZ)' CONFIG_FT_INTERNAL $CONFIG_FTAPE
if [ "$CONFIG_FT_INTERNAL" = "y" -o \
     "$CONFIG_FT_INTERNAL" = "m" -a \
     "$CONFIG_EXPERIMENTAL" = "y" ]; then
  int 'Number of ftape buffers for internal FDC (EXPERIMENTAL)' CONFIG_FT_NR_BUFFERS 3
fi
dep_tristate 'Driver for Colorado Trakker parport drive' CONFIG_FT_TRAKKER $CONFIG_FTAPE
dep_tristate 'Driver for Micro Solutions Backpack parport drive' CONFIG_FT_BPCK $CONFIG_FTAPE
if [ "$CONFIG_FT_TRAKKER" = "y" -o \
     "$CONFIG_FT_TRAKKER" = "m" -o \
     "$CONFIG_FT_BPCK"    = "y" -o \
     "$CONFIG_FT_BPCK"    = "m" ]; then
    define_bool CONFIG_FT_PARPORT y
else
    define_bool CONFIG_FT_PARPORT n
fi
if [ "$CONFIG_FT_INTERNAL" = "y" -o \
     "$CONFIG_FT_INTERNAL" = "m" -o \
     "$CONFIG_FT_PARPORT" = "y" ]; then
    comment
    comment 'Hardware configuration, first ftape device'
    comment '~~~~~~~~~~~~~~~~~~~~~~~~~~~~~~~~~~~~~~~~~~'
    #
    # first device /dev/*ft0
    #
    choice 'FDC driver for first ftape device'			\
	    "Internal			CONFIG_FT_INT_0		\
	     Parallel			CONFIG_FT_PAR_0		\
	     Auto                       CONFIG_FT_AUTO_0	\
	     None                       CONFIG_FT_NONE_0" Auto
    #
    if [ "$CONFIG_FT_PARPORT" = "n" -a "$CONFIG_FT_PAR_0" = "y" ]; then
	define_bool CONFIG_FT_SKIP_0 y
    else
	if [ "$CONFIG_FT_INTERNAL" = "n" -a "$CONFIG_FT_INT_0" = "y" ]; then
	    define_bool CONFIG_FT_SKIP_0 y
	else
	    if [ "$CONFIG_FT_NONE_0" = "y" ]; then
		define_bool CONFIG_FT_SKIP_0 y
	    else
		define_bool CONFIG_FT_SKIP_0 n
	    fi
	fi
    fi

    if [ "$CONFIG_FT_SKIP_0" != "y" ]; then
	if [ "$CONFIG_FT_INTERNAL" != "n" ]; then
	    if [ "$CONFIG_FT_INT_0" = "y" -o "$CONFIG_FT_AUTO_0" = "y" ]; then
		comment 'Internal FDC setup'
		choice 'Internal Floppy Tape Controllers'		\
		"Standard			CONFIG_FT_STD_FDC_0	\
		 MACH-2				CONFIG_FT_MACH2_0	\
		 FC-10/FC-20			CONFIG_FT_FC10_0	\
		 Alt/82078			CONFIG_FT_ALT_FDC_0" Standard
	#
		if [ "$CONFIG_FT_MACH2_0" = "y" -o \
		     "$CONFIG_FT_FC10_0" = "y" -o \
		     "$CONFIG_FT_ALT_FDC_0" = "y" ]; then
		    bool 'Detailed Hardware Setup' CONFIG_FT_INT_HW_0 n
		    if [ "$CONFIG_FT_INT_HW_0" = "y" ]; then
			comment 'Consult the manuals of your tape drive for the correct settings!'
			hex ' IO base of the floppy disk controller' \
				CONFIG_FT_FDC_BASE_0 -1
			int ' IRQ channel of the floppy disk controller' \
				CONFIG_FT_FDC_IRQ_0 -1
			int ' DMA channel of the floppy disk controller' \
				CONFIG_FT_FDC_DMA_0 -1
			comment
		    fi
		fi
	    fi
	fi
	if [ "$CONFIG_FT_PARPORT" != "n" ]; then
	    if [ "$CONFIG_FT_PAR_0" = "y" -o "$CONFIG_FT_AUTO_0" = "y" ]; then
		comment 'Parallel Port FDC setup'
		choice 'Parallel Port Floppy Tape Controllers'	    \
		    "Trakker		CONFIG_FT_TRAKKER_0	    \
		     Backpack		CONFIG_FT_BPCK_0	    \
		     Trakker:Backpack	CONFIG_FT_TRAKKERBPCK_0"    \
		     Trakker:Backpack
		bool 'Detailed Hardware Setup' CONFIG_FT_PAR_HW_0 n
		if [ "$CONFIG_FT_PAR_HW_0" = "y" ]; then
			hex ' IO base of the parallel port' \
				CONFIG_FT_FDC_BASE_0 -1
			int ' IRQ channel of the parallel port' \
				CONFIG_FT_FDC_IRQ_0 -1
			comment
		else
		    int 'Parport Number to Use' CONFIG_FT_FDC_PARPORT_0 -1
		fi
	    fi
	fi
	comment 'General FDC options'
	int 'Default FIFO threshold' CONFIG_FT_FDC_THRESHOLD_0 8
	int 'Maximal data rate to use' CONFIG_FT_FDC_MAX_RATE_0 4000
    fi
    comment
    comment 'Hardware configuration, second ftape device'
    comment '~~~~~~~~~~~~~~~~~~~~~~~~~~~~~~~~~~~~~~~~~~'
    #
    # second device /dev/*ft1
    #
    choice 'FDC driver for second ftape device'			\
	    "Internal			CONFIG_FT_INT_1		\
	     Parallel			CONFIG_FT_PAR_1		\
	     Auto                       CONFIG_FT_AUTO_1	\
	     None                       CONFIG_FT_NONE_1" None
    #
    if [ "$CONFIG_FT_PARPORT" = "n" -a "$CONFIG_FT_PAR_1" = "y" ]; then
	define_bool CONFIG_FT_SKIP_1 y
    else
	if [ "$CONFIG_FT_INTERNAL" = "n" -a "$CONFIG_FT_INT_1" = "y" ]; then
	    define_bool CONFIG_FT_SKIP_1 y
	else
	    if [ "$CONFIG_FT_NONE_1" = "y" ]; then
		define_bool CONFIG_FT_SKIP_1 y
	    else
		define_bool CONFIG_FT_SKIP_1 n
	    fi
	fi
    fi

    if [ "$CONFIG_FT_SKIP_1" != "y" ]; then
	if [ "$CONFIG_FT_INTERNAL" != "n" ]; then
	    if [ "$CONFIG_FT_INT_1" = "y" -o "$CONFIG_FT_AUTO_1" = "y" ]; then
		comment 'Internal FDC setup'
		choice 'Internal Floppy Tape Controllers'		\
		"Standard			CONFIG_FT_STD_FDC_1	\
		 MACH-2				CONFIG_FT_MACH2_1	\
		 FC-10/FC-20			CONFIG_FT_FC10_1	\
		 Alt/82078			CONFIG_FT_ALT_FDC_1" Standard
	#
		if [ "$CONFIG_FT_MACH2_1" = "y" -o \
		     "$CONFIG_FT_FC10_1" = "y" -o \
		     "$CONFIG_FT_ALT_FDC_1" = "y" ]; then
		    bool 'Detailed Hardware Setup' CONFIG_FT_INT_HW_1 n
		    if [ "$CONFIG_FT_INT_HW_1" = "y" ]; then
			comment 'Consult the manuals of your tape drive for the correct settings!'
			hex ' IO base of the floppy disk controller' \
				CONFIG_FT_FDC_BASE_1 -1
			int ' IRQ channel of the floppy disk controller' \
				CONFIG_FT_FDC_IRQ_1 -1
			int ' DMA channel of the floppy disk controller' \
				CONFIG_FT_FDC_DMA_1 -1
			comment
		    fi
		fi
	    fi
	fi
	if [ "$CONFIG_FT_PARPORT" != "n" ]; then
	    if [ "$CONFIG_FT_PAR_1" = "y" -o "$CONFIG_FT_AUTO_1" = "y" ]; then
		comment 'Parallel Port FDC setup'
		choice 'Parallel Port Floppy Tape Controllers'	    \
		    "Trakker		CONFIG_FT_TRAKKER_1	    \
		     Backpack		CONFIG_FT_BPCK_1	    \
		     Trakker:Backpack	CONFIG_FT_TRAKKERBPCK_1"    \
		     Trakker:Backpack
		bool 'Detailed Hardware Setup' CONFIG_FT_PAR_HW_1 n
		if [ "$CONFIG_FT_PAR_HW_1" = "y" ]; then
			hex ' IO base of the parallel port' \
				CONFIG_FT_FDC_BASE_1 -1
			int ' IRQ channel of the parallel port' \
				CONFIG_FT_FDC_IRQ_1 -1
			comment
		else
		    int 'Parport Number to Use' CONFIG_FT_FDC_PARPORT_1 -1
		fi
	    fi
	fi
	comment 'General FDC options'
	int 'Default FIFO threshold' CONFIG_FT_FDC_THRESHOLD_1 8
	int 'Maximal data rate to use' CONFIG_FT_FDC_MAX_RATE_1 4000
    fi
    comment
    comment 'Hardware configuration, third ftape device'
    comment '~~~~~~~~~~~~~~~~~~~~~~~~~~~~~~~~~~~~~~~~~~'
    #
    # third device /dev/*ft2
    #
    choice 'FDC driver for third ftape device'			\
	    "Internal			CONFIG_FT_INT_2		\
	     Parallel			CONFIG_FT_PAR_2		\
	     Auto                       CONFIG_FT_AUTO_2	\
	     None                       CONFIG_FT_NONE_2" None
    #
    if [ "$CONFIG_FT_PARPORT" = "n" -a "$CONFIG_FT_PAR_2" = "y" ]; then
	define_bool CONFIG_FT_SKIP_2 y
    else
	if [ "$CONFIG_FT_INTERNAL" = "n" -a "$CONFIG_FT_INT_2" = "y" ]; then
	    define_bool CONFIG_FT_SKIP_2 y
	else
	    if [ "$CONFIG_FT_NONE_2" = "y" ]; then
		define_bool CONFIG_FT_SKIP_2 y
	    else
		define_bool CONFIG_FT_SKIP_2 n
	    fi
	fi
    fi

    if [ "$CONFIG_FT_SKIP_2" != "y" ]; then
	if [ "$CONFIG_FT_INTERNAL" != "n" ]; then
	    if [ "$CONFIG_FT_INT_2" = "y" -o "$CONFIG_FT_AUTO_2" = "y" ]; then
		comment 'Internal FDC setup'
		choice 'Internal Floppy Tape Controllers'		\
		"Standard			CONFIG_FT_STD_FDC_2	\
		 MACH-2				CONFIG_FT_MACH2_2	\
		 FC-10/FC-20			CONFIG_FT_FC10_2	\
		 Alt/82078			CONFIG_FT_ALT_FDC_2" Standard
	#
		if [ "$CONFIG_FT_MACH2_2" = "y" -o \
		     "$CONFIG_FT_FC10_2" = "y" -o \
		     "$CONFIG_FT_ALT_FDC_2" = "y" ]; then
		    bool 'Detailed Hardware Setup' CONFIG_FT_INT_HW_2 n
		    if [ "$CONFIG_FT_INT_HW_2" = "y" ]; then
			comment 'Consult the manuals of your tape drive for the correct settings!'
			hex ' IO base of the floppy disk controller' \
				CONFIG_FT_FDC_BASE_2 -1
			int ' IRQ channel of the floppy disk controller' \
				CONFIG_FT_FDC_IRQ_2 -1
			int ' DMA channel of the floppy disk controller' \
				CONFIG_FT_FDC_DMA_2 -1
			comment
		    fi
		fi
	    fi
	fi
	if [ "$CONFIG_FT_PARPORT" != "n" ]; then
	    if [ "$CONFIG_FT_PAR_2" = "y" -o "$CONFIG_FT_AUTO_2" = "y" ]; then
		comment 'Parallel Port FDC setup'
		choice 'Parallel Port Floppy Tape Controllers'	    \
		    "Trakker		CONFIG_FT_TRAKKER_2	    \
		     Backpack		CONFIG_FT_BPCK_2	    \
		     Trakker:Backpack	CONFIG_FT_TRAKKERBPCK_2"    \
		     Trakker:Backpack
		bool 'Detailed Hardware Setup' CONFIG_FT_PAR_HW_2 n
		if [ "$CONFIG_FT_PAR_HW_2" = "y" ]; then
			hex ' IO base of the parallel port' \
				CONFIG_FT_FDC_BASE_2 -1
			int ' IRQ channel of the parallel port' \
				CONFIG_FT_FDC_IRQ_2 -1
			comment
		else
		    int 'Parport Number to Use' CONFIG_FT_FDC_PARPORT_2 -1
		fi
	    fi
	fi
	comment 'General FDC options'
	int 'Default FIFO threshold' CONFIG_FT_FDC_THRESHOLD_2 8
	int 'Maximal data rate to use' CONFIG_FT_FDC_MAX_RATE_2 4000
    fi
    comment
    comment 'Hardware configuration, fourth ftape device'
    comment '~~~~~~~~~~~~~~~~~~~~~~~~~~~~~~~~~~~~~~~~~~'
    #
    # fourth device /dev/*ft0
    #
    choice 'FDC driver for fourth ftape device'			\
	    "Internal			CONFIG_FT_INT_3		\
	     Parallel			CONFIG_FT_PAR_3		\
	     Auto                       CONFIG_FT_AUTO_3	\
	     None                       CONFIG_FT_NONE_3" None
    #
    if [ "$CONFIG_FT_PARPORT" = "n" -a "$CONFIG_FT_PAR_3" = "y" ]; then
	define_bool CONFIG_FT_SKIP_3 y
    else
	if [ "$CONFIG_FT_INTERNAL" = "n" -a "$CONFIG_FT_INT_3" = "y" ]; then
	    define_bool CONFIG_FT_SKIP_3 y
	else
	    if [ "$CONFIG_FT_NONE_3" = "y" ]; then
		define_bool CONFIG_FT_SKIP_3 y
	    else
		define_bool CONFIG_FT_SKIP_3 n
	    fi
	fi
    fi

    if [ "$CONFIG_FT_SKIP_3" != "y" ]; then
	if [ "$CONFIG_FT_INTERNAL" != "n" ]; then
	    if [ "$CONFIG_FT_INT_3" = "y" -o "$CONFIG_FT_AUTO_3" = "y" ]; then
		comment 'Internal FDC setup'
		choice 'Internal Floppy Tape Controllers'		\
		"Standard			CONFIG_FT_STD_FDC_3	\
		 MACH-2				CONFIG_FT_MACH2_3	\
		 FC-10/FC-20			CONFIG_FT_FC10_3	\
		 Alt/82078			CONFIG_FT_ALT_FDC_3" Standard
	#
		if [ "$CONFIG_FT_MACH2_3" = "y" -o \
		     "$CONFIG_FT_FC10_3" = "y" -o \
		     "$CONFIG_FT_ALT_FDC_3" = "y" ]; then
		    bool 'Detailed Hardware Setup' CONFIG_FT_INT_HW_3 n
		    if [ "$CONFIG_FT_INT_HW_3" = "y" ]; then
			comment 'Consult the manuals of your tape drive for the correct settings!'
			hex ' IO base of the floppy disk controller' \
				CONFIG_FT_FDC_BASE_3 -1
			int ' IRQ channel of the floppy disk controller' \
				CONFIG_FT_FDC_IRQ_3 -1
			int ' DMA channel of the floppy disk controller' \
				CONFIG_FT_FDC_DMA_3 -1
			comment
		    fi
		fi
	    fi
	fi
	if [ "$CONFIG_FT_PARPORT" != "n" ]; then
	    if [ "$CONFIG_FT_PAR_3" = "y" -o "$CONFIG_FT_AUTO_3" = "y" ]; then
		comment 'Parallel Port FDC setup'
		choice 'Parallel Port Floppy Tape Controllers'	    \
		    "Trakker		CONFIG_FT_TRAKKER_3	    \
		     Backpack		CONFIG_FT_BPCK_3	    \
		     Trakker:Backpack	CONFIG_FT_TRAKKERBPCK_3"    \
		     Trakker:Backpack
		bool 'Detailed Hardware Setup' CONFIG_FT_PAR_HW_3 n
		if [ "$CONFIG_FT_PAR_HW_3" = "y" ]; then
			hex ' IO base of the parallel port' \
				CONFIG_FT_FDC_BASE_3 -1
			int ' IRQ channel of the parallel port' \
				CONFIG_FT_FDC_IRQ_3 -1
			comment
		else
		    int 'Parport Number to Use' CONFIG_FT_FDC_PARPORT_3 -1
		fi
	    fi
	fi
	comment 'General FDC options'
	int 'Default FIFO threshold' CONFIG_FT_FDC_THRESHOLD_3 8
	int 'Maximal data rate to use' CONFIG_FT_FDC_MAX_RATE_3 4000
    fi
fi
```
